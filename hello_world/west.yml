## hello_world/west.yml
```yaml
# (c) Copyright 2025, Sensoteq Limited.
# ALL RIGHTS RESERVED


manifest:
  self: {}

  remotes:
    - name: ncs
      url-base: https://github.com/nrfconnect

  projects:
    - name: nrf
      remote: ncs
      repo-path: sdk-nrf
      revision: v3.0.2
      import: true
```
